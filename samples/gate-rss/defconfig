## samples/helloworld/defconfig
```kconfig
CONFIG_ARCH_X86_64=y
CONFIG_PLAT_KVM=y
CONFIG_KVM_VMM_QEMU=y
CONFIG_KVM_BOOT_PROTO_MULTIBOOT=y
CONFIG_LIBUKBOOT=y
CONFIG_LIBUKBOOT_BANNER_POWEREDBY=y
CONFIG_LIBUKCONSOLE=y
CONFIG_LIBNS16550=y
CONFIG_LIBNS16550_EARLY_CONSOLE=y
CONFIG_LIBNS16550_COM_AVAIL=y
CONFIG_LIBNS16550_COM1=y
CONFIG_LIBNS16550_COM1_BAUD_115200=y
CONFIG_LIBNS16550_COM1_EARLY=y
CONFIG_LIBUKDEBUG=y
CONFIG_LIBUKDEBUG_PRINTK=y
CONFIG_LIBUKDEBUG_PRINTK_INFO=y
CONFIG_LIBUKALLOC=y
CONFIG_LIBUKALLOCBBUDDY=y
CONFIG_LIBUKBUS=y
CONFIG_LIBUKBUS_PCI=y
CONFIG_LIBUKNETDEV=y
CONFIG_LIBVIRTIO_BUS=y
CONFIG_LIBVIRTIO_PCI=y
CONFIG_LIBVIRTIO_NET=y
CONFIG_LIBUKSGLIST=y
CONFIG_UK_DEFNAME="helloworld"
CONFIG_UK_NAME="helloworld"
```
